/* SPDX-License-Identifier: GPL-2.0-only */

/dts-v1/;

#include "sdm710.dtsi"
#include "sdm710-xiaomi.dtsi"

/ {
	model = "Qualcomm Technologies, Inc. SDM710 SoC, Xiaomi";
	compatible = "qcom,sdm670";
	qcom,board-id = <0 0>;
};
