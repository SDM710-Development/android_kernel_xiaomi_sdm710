/* SPDX-License-Identifier: GPL-2.0-only */

#include "xiaomi-audio-overlay.dtsi"

&int_codec {
	qcom,msm-mbhc-usbc-audio-supported = <1>;
	qcom,usbc-analog-en1-gpio = <&pm660_gpios 13 0>;
	qcom,usbc-analog-en2-gpio = <&tlmm 40 0>;
	pinctrl-names = "aud_active", "aud_sleep";
	pinctrl-0 = <&wcd_usbc_analog_en2_active>;
	pinctrl-1 = <&wcd_usbc_analog_en2_idle>;
};
