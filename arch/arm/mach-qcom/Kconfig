## arch/arm/mach-qcom/Kconfig
```kconfig
if ARCH_QCOM
menu "QCOM SoC Type"

config ARCH_MSM8X60
	bool "Enable support for MSM8X60"
	select ARCH_SUPPORTS_BIG_ENDIAN
	select ARM_AMBA
	select QCOM_SCM if SMP
	select CLKSRC_QCOM
	select CLKSRC_OF
	select COMMON_CLK

config ARCH_MSM8960
	bool "Enable support for MSM8960"
	select CLKSRC_QCOM
	select ARCH_SUPPORTS_BIG_ENDIAN
	select ARM_AMBA
	select QCOM_SCM if SMP
	select CLKSRC_OF
	select COMMON_CLK


config ARCH_MSM8974
	bool "Enable support for MSM8974"
	select HAVE_ARM_ARCH_TIMER
	select ARCH_SUPPORTS_BIG_ENDIAN
	select ARM_AMBA
	select QCOM_SCM if SMP
	select CLKSRC_OF
	select COMMON_CLK

config ARCH_MDM9615
	bool "Enable support for MDM9615"
	select CLKSRC_QCOM
	select ARCH_SUPPORTS_BIG_ENDIAN
	select ARM_AMBA
	select QCOM_SCM if SMP
	select CLKSRC_OF
	select COMMON_CLK

config ARCH_SDXPOORWILLS
	bool "Enable support for SDXPOORWILLS"
	select CPU_V7
	select HAVE_ARM_ARCH_TIMER
	select MSM_CORTEX_A7
	select PINCTRL
	select PCI
	select QCOM_SCM if SMP
	select MSM_JTAG_MM if CORESIGHT_ETM
	select PM_DEVFREQ
	select COMMON_CLK
	select COMMON_CLK_QCOM
	select QCOM_GDSC
	select GENERIC_CLOCKEVENTS_BROADCAST
	select AUDIO_EXT_CLK
	select MSM_ADSP_LOADER
	select MSM_CDC_PINCTRL
	select MSM_QDSP6_APRV3_GLINK
	select MSM_QDSP6_NOTIFIER
	select MSM_QDSP6_PDR
	select MSM_QDSP6_SSR
	select MSM_QDSP6V2_CODECS
	select PINCTRL_WCD
	select QTI_PP
	select REGMAP_SWR
	select SND_HWDEP_ROUTING
	select SND_SOC_MACHINE_SDXPOORWILLS
	select SND_SOC_MSM_HOSTLESS_PCM
	select SND_SOC_MSM_QDSP6V2_INTF
	select SND_SOC_MSM_QDSP6V2_INTF
	select SND_SOC_MSM_QDSP6V2_INTF
	select SND_SOC_MSM_STUB
	select SND_SOC_POORWILLS
	select SND_SOC_QDSP6V2
	select SND_SOC_WCD_DSP_MGR
	select SND_SOC_WCD_MBHC
	select SND_SOC_WCD_MBHC_ADC
	select SND_SOC_WCD9XXX_V2
	select SND_SOC_WCD934X
	select SND_SOC_WCD934X
	select SND_SOC_WCD934X_DSD
	select SND_SOC_WCD934X_MBHC
	select SND_SOC_WSA881X
	select SOUNDWIRE
	select SOUNDWIRE_WCD_CTRL
	select WCD9XXX_CODEC_CORE

config ARCH_MSM8953
	bool "Enable support for MSM8953"
	select CPU_V7
	select HAVE_ARM_ARCH_TIMER
	select PINCTRL
	select QCOM_SCM if SMP
	select PM_DEVFREQ
	select CLKDEV_LOOKUP
	select HAVE_CLK
	select HAVE_CLK_PREPARE
	select COMMON_CLK_MSM
	select ARCH_MSM8953_SOC_SETTINGS

config ARCH_MSM8953_BOOT_ORDERING
	bool "Enable support for MSM8953 device boot ordering"
	default n
	help
	  Populate devices from devicetree at late_init, after
	  drivers for all platform devices have been registered.
	  This causes devices to be probed in the order they are
	  listed in devicetree. Thus it is possible to have
	  greater control over the probe ordering such that
	  overall boot time can be reduced.

config ARCH_MSM8937
	bool "Enable support for MSM8937"
	select CPU_V7
	select HAVE_ARM_ARCH_TIMER
	select PINCTRL
	select QCOM_SCM if SMP
	select PM_DEVFREQ
	select CLKDEV_LOOKUP
	select HAVE_CLK
	select HAVE_CLK_PREPARE
	select COMMON_CLK_MSM

config ARCH_MSM8909
	bool "Enable support for MSM8909"
	select HAVE_ARM_ARCH_TIMER
	select MAY_HAVE_SPARSE_IRQ
	select PINCTRL_MSM_TLMM
	select USE_PINCTRL_IRQ
	select MSM_PM_LEGACY if PM
	select MSM_RPM_SMD
	select MSM_RPM_STATS_LOG
	select MSM_RPM_LOG
	select MSM_CORTEX_A7
	select QCOM_SCM if SMP
	select CPU_FREQ
	select CPU_FREQ_MSM
	select PM_DEVFREQ
	select PM_OPP
	select QCOM_DEVFREQ_DEVBW
	select DEVFREQ_SIMPLE_DEV
	select DEVFREQ_GOV_QCOM_BW_HWMON
	select QCOM_BIMC_BWMON
	select CLKDEV_LOOKUP
	select HAVE_CLK
	select HAVE_CLK_PREPARE
	select COMMON_CLK_MSM
	select AUDIO_EXT_CLK
	select MSM_ADSP_LOADER
	select MSM_BG_GLINK
	select MSM_CDC_PINCTRL
	select MSM_QDSP6_APRV3
	select MSM_QDSP6_NOTIFIER
	select MSM_QDSP6_SSR
	select MSM_QDSP6V2_CODECS
	select MSM_ULTRASOUND
	select PINCTRL_WCD
	select QTI_PP
	select REGMAP_SWR
	select SND_HWDEP_ROUTING
	select SND_SOC_ANALOG_CDC
	select SND_SOC_BG_CODEC
	select SND_SOC_BG_8909
	select SND_SOC_CPE
	select SND_SOC_DIGITAL_CDC_LEGACY
	select SND_SOC_EXT_CODEC_8909
	select SND_SOC_I2C_AND_SPI
	select SND_SOC_MSM_HDMI_CODEC_RX
	select SND_SOC_MSM_HOSTLESS_PCM
	select SND_SOC_MSM_QDSP6V2_INTF
	select SND_SOC_MSM_STUB
	select SND_SOC_MSM8909
	select SND_SOC_QDSP6V2
	select SND_SOC_SDM660_CDC
	select SND_SOC_WCD_CPE
	select SND_SOC_WCD_MBHC
	select SND_SOC_WCD_MBHC_LEGACY
	select SND_SOC_WCD9XXX_V2
	select SND_SOC_WCD9335
	select SND_SOC_WSA881X
	select SND_SOC_WSA881X_ANALOG
	select SND_SOC_8909_DIG_CDC
	select SOUNDWIRE
	select SOUNDWIRE_WCD_CTRL
	select WCD_DSP_GLINK
	select WCD9XXX_CODEC_CORE

config ARCH_MSM8917
	bool "Enable support for MSM8917"
	select CPU_V7
	select HAVE_ARM_ARCH_TIMER
	select PINCTRL
	select QCOM_SCM if SMP
	select PM_DEVFREQ
	select CLKDEV_LOOKUP
	select HAVE_CLK
	select HAVE_CLK_PREPARE
	select COMMON_CLK_MSM

config ARCH_QM215
	bool "Enable support for QM215"
	select CPU_V7
	select HAVE_ARM_ARCH_TIMER
	select PINCTRL
	select QCOM_SCM if SMP
	select PM_DEVFREQ
	select CLKDEV_LOOKUP
	select HAVE_CLK
	select HAVE_CLK_PREPARE
	select COMMON_CLK_MSM

config ARCH_MSM8940
	bool "Enable support for MSM8940"
	select CPU_V7
	select HAVE_ARM_ARCH_TIMER
	select PINCTRL
	select QCOM_SCM if SMP
	select PM_DEVFREQ
	select CLKDEV_LOOKUP
	select HAVE_CLK
	select HAVE_CLK_PREPARE
	select COMMON_CLK_MSM

config ARCH_SDM439
	bool "Enable support for SDM439"
	select CPU_V7
	select HAVE_ARM_ARCH_TIMER
	select PINCTRL
	select QCOM_SCM if SMP
	select PM_DEVFREQ
	select CLKDEV_LOOKUP
	select HAVE_CLK
	select HAVE_CLK_PREPARE
	select COMMON_CLK_MSM

config ARCH_SDM429
	bool "Enable support for SDM429"
	select CPU_V7
	select HAVE_ARM_ARCH_TIMER
	select PINCTRL
	select QCOM_SCM if SMP
	select PM_DEVFREQ
	select CLKDEV_LOOKUP
	select HAVE_CLK
	select HAVE_CLK_PREPARE
	select COMMON_CLK_MSM

config ARCH_SDM450
	bool "Enable support for SDM450"
	select CPU_V7
	select HAVE_ARM_ARCH_TIMER
	select PINCTRL
	select QCOM_SCM if SMP
	select PM_DEVFREQ
	select CLKDEV_LOOKUP
	select HAVE_CLK
	select HAVE_CLK_PREPARE
	select COMMON_CLK_MSM
	select ARCH_MSM8953_SOC_SETTINGS
	select AUDIO_EXT_CLK
	select AVTIMER_LEGACY
	select DOLBY_DS2
	select DOLBY_LICENSE
	select DTS_EAGLE
	select DTS_SRS_TM
	select MSM_ADSP_LOADER
	select MSM_AVTIMER
	select MSM_CDC_PINCTRL
	select MSM_QDSP6_APRV2
	select MSM_QDSP6_NOTIFIER
	select MSM_QDSP6_SSR
	select MSM_QDSP6V2_CODECS
	select MSM_ULTRASOUND
	select PINCTRL_WCD
	select QTI_PP_AUDIOSPHERE
	select QTI_PP
	select REGMAP_SWR
	select SND_HWDEP_ROUTING
	select SND_SOC_ANALOG_CDC
	select SND_SOC_CPE
	select SND_SOC_DIGITAL_CDC_LEGACY
	select SND_SOC_EXT_CODEC_SDM450
	select SND_SOC_MSM_HDMI_CODEC_RX
	select SND_SOC_MSM_HOSTLESS_PCM
	select SND_SOC_MSM_QDSP6V2_INTF
	select SND_SOC_MSM_QDSP6V2_INTF
	select SND_SOC_MSM_STUB
	select SND_SOC_QDSP6V2
	select SND_SOC_SDM450
	select SND_SOC_SDM660_CDC
	select SND_SOC_WCD_CPE
	select SND_SOC_WCD_MBHC_LEGACY
	select SND_SOC_WCD_MBHC
	select SND_SOC_WCD9XXX_V2
	select SND_SOC_WCD9335
	select SND_SOC_WSA881X_ANALOG
	select SND_SOC_WSA881X
	select SOUNDWIRE
	select SOUNDWIRE_WCD_CTRL
	select WCD_DSP_GLINK
	select WCD9XXX_CODEC_CORE

config ARCH_SDM632
	bool "Enable Support for Qualcomm Technologies Inc. SDM632"
	select CPU_V7
	select PINCTRL
	select QCOM_SCM if SMP
	select CLKDEV_LOOKUP
	select HAVE_CLK
	select HAVE_CLK_PREPARE
	select SOC_BUS
	select PM_OPP
	select MFD_CORE
	select SND_SOC_COMPRESS
	select SND_HWDEP
	select CPU_FREQ_QCOM
	select COMMON_CLK_MSM
	select ARCH_MSM8953_SOC_SETTINGS

config ARCH_SDM670
        bool "Enable Support for SDM670"
	select CPU_V7
	select CLKDEV_LOOKUP
	select HAVE_CLK
	select HAVE_CLK_PREPARE
	select PM_OPP
	select SOC_BUS
	select MSM_IRQ
	select THERMAL_WRITABLE_TRIPS
	select ARM_GIC_V3
	select ARM_AMBA
	select SPARSE_IRQ
	select MULTI_IRQ_HANDLER
	select HAVE_ARM_ARCH_TIMER
	select MAY_HAVE_SPARSE_IRQ
	select COMMON_CLK
	select COMMON_CLK_QCOM
	select QCOM_GDSC
	select PINCTRL_MSM_TLMM
	select PCI
	select USE_PINCTRL_IRQ
	select MSM_PM if PM
	select QMI_ENCDEC
	select CPU_FREQ
	select PM_DEVFREQ
	select MSM_DEVFREQ_DEVBW
	select DEVFREQ_SIMPLE_DEV
	select DEVFREQ_GOV_MSM_BW_HWMON
	select MSM_BIMC_BWMON
	select MSM_QDSP6V2_CODECS
	select MSM_AUDIO_QDSP6V2 if SND_SOC
	select GENERIC_IRQ_MIGRATION

config ARCH_MDM9650
	bool "MDM9650"
	select ARM_GIC
	select CPU_V7
	select REGULATOR
	select REGULATOR_RPM_SMD
	select HAVE_ARM_ARCH_TIMER
	select MSM_RPM_SMD
	select MSM_SPM
	select MSM_PM if PM
	select QMI_ENCDEC
	select MSM_CORTEX_A7
	select PINCTRL
	select PINCTRL_MSM_TLMM
	select USE_PINCTRL_IRQ
	select PCI
	select MSM_IRQ
	select MSM_JTAG_MM if CORESIGHT_ETM
	select MSM_CLK_CONTROLLER_V2
	select PM_DEVFREQ
	select MSM_DEVFREQ_DEVBW
	select DEVFREQ_SIMPLE_DEV
	select MSM_RPM_LOG
	select MSM_RPM_STATS_LOG
	select HAVE_CLK_PREPARE

config ARCH_MDM9607
	bool "MDM9607"
	select ARM_GIC
	select CPU_V7
	select REGULATOR
	select REGULATOR_RPM_SMD
	select HAVE_ARM_ARCH_TIMER
	select MSM_RPM_SMD
	select MEMORY_HOLE_CARVEOUT
	select MSM_CORTEX_A7
	select PINCTRL
	select PINCTRL_MSM_TLMM
	select USE_PINCTRL_IRQ
	select MSM_IRQ
	select MSM_PM if PM
	select PM_DEVFREQ
	select MSM_DEVFREQ_DEVBW
	select MSM_BIMC_BWMON
	select DEVFREQ_GOV_MSM_BW_HWMON
	select ARM_HAS_SG_CHAIN
	select HAVE_CLK_PREPARE

endmenu
endif
```

## drivers/input/fingerprint/goodix_fp/Kconfig
```kconfig
menuconfig FINGERPRINT_GOODIX_FP
	tristate "Goodix fingerprint sensor"
	depends on INPUT_FINGERPRINT
	help
	  Say Y here to enable support for Goodix fingerprint sensor.

	  If unsure, say N.

	  To compile this driver as a module, choose M here.

if FINGERPRINT_GOODIX_FP

choice
	prompt "Goodix fingerprint sensor bus support"
	default GOODIX_FP_PLATFORM

config GOODIX_FP_SPI
	bool "SPI bus support"
	depends on SPI
	help
	  Say Y here if you want to enable support for Goodix fingerprint
	  sensor through SPI bus.

config GOODIX_FP_PLATFORM
	bool "Platform bus support"
	help
	  Say Y here if you want to enable support for Goodix fingerprint
	  sensor through platform bus.

endchoice

config GOODIX_FP_NAV_EVENT
	bool "Navigation events support"
	help
	  Say Y here if you want to enable support for navigation events
	  in Goodix fingerprint sensor driver

config GOODIX_FP_POWER_CTRL
	bool "Power control support"
	help
	  Say Y here if you want to enable power control in Goodix
	  fingerprint sensor driver.

config GOODIX_FP_CLK_CTRL
	bool "SPI clock control support"
	depends on GOODIX_FP_SPI
	help
	  Say Y here if you want to enable SPI clock control support
	  in Goodix fingerprint sensor driver.

config GOODIX_FP_NETLINK
	bool "Netlink notification support"
	help
	  Say Y here if you want to enable notification support through
	  netlink in Goodix fingerprint sensor driver.

config GOODIX_FP_DRM_EVENTS
	bool "Handle DRM blank/unblank events"
	help
	  Say Y here if you want Goodix fingerprint sensor driver
	  to listen and handle blank/unblank events sent by DRM.

config GOODIX_FP_PANEL_LIGHT_ON
	bool "Light-on panel when finger touches the sensor"
	depends on GOODIX_FP_DRM_EVENTS
	help
	  Say Y here if you want Goodix fingerprint sensor driver
	  to light panel on when finger touches the sensor.

endif
```

## drivers/input/touchscreen/focaltech_touch_f3b/Kconfig
```kconfig
#
# Focaltech Touchscreen driver configuration
#

config TOUCHSCREEN_FTS_F3B
	bool "Focaltech Touchscreen"
	depends on I2C
	default n
	help
	  Say Y here if you have Focaltech touch panel.
	  If unsure, say N.

if TOUCHSCREEN_FTS_F3B

config TOUCHSCREEN_FTS_FOD_F3B
	bool "Focaltech Touchscreen Fod func"
	default n
	help
	  Say Y here if you support fod function.
	  If unsure, say N.

config TOUCHSCREEN_FTS_DIRECTORY_F3B
	string "Focaltech ts directory name"
	default "focaltech_touch_f3b"

endif
```

## techpack/audio/Kconfig
```kconfig
source "techpack/audio/asoc/Kconfig"
source "techpack/audio/dsp/Kconfig"
source "techpack/audio/ipc/Kconfig"
source "techpack/audio/soc/Kconfig"
```

## techpack/audio/asoc/Kconfig
```kconfig
config DOLBY_DS2
	bool

config DOLBY_LICENSE
	bool

config QTI_PP
	bool

config SND_HWDEP_ROUTING
	bool

config SND_SOC_BG_8909
	bool

config SND_SOC_CPE
	bool

config SND_SOC_EXT_CODEC
	bool

config SND_SOC_EXT_CODEC_SDM450
	bool

config SND_SOC_EXT_CODEC_8909
	bool

config SND_SOC_INT_CODEC
	bool

config SND_SOC_MACHINE_SDM845
	bool

config SND_SOC_MACHINE_SDXPOORWILLS
	bool

config SND_SOC_MSM8909
	bool

config SND_SOC_QDSP6V2
	bool

config SND_SOC_SDM450
	bool

config SND_SOC_SDM670
	bool

config SND_SOC_8909_DIG_CDC
	bool

source "techpack/audio/asoc/codecs/Kconfig"
```

## techpack/audio/asoc/codecs/Kconfig
```kconfig
config SND_SOC_MSM_HDMI_CODEC_RX
	bool

config SND_SOC_MSM_STUB
	bool

config SND_SOC_WCD_CPE
	bool

config SND_SOC_WCD_MBHC
	bool

config SND_SOC_WCD_MBHC_ADC
	bool

config SND_SOC_WCD_MBHC_LEGACY
	bool

config SND_SOC_WCD_SPI
	bool

config SND_SOC_WCD9XXX_V2
	bool

config SND_SOC_WCD9335
	bool

config SND_SOC_WSA881X
	bool

config SND_SOC_WSA881X_ANALOG
	bool

config WCD9XXX_CODEC_CORE
	bool

config SPK_ID
	bool

source "techpack/audio/asoc/codecs/cs35l41/Kconfig"
source "techpack/audio/asoc/codecs/msm_sdw/Kconfig"
source "techpack/audio/asoc/codecs/sdm660_cdc/Kconfig"
source "techpack/audio/asoc/codecs/tas2557/Kconfig"
source "techpack/audio/asoc/codecs/tas2562/Kconfig"
source "techpack/audio/asoc/codecs/wcd934x/Kconfig"
```

## techpack/audio/asoc/codecs/sdm660_cdc/Kconfig
```kconfig
config SND_SOC_ANALOG_CDC
	bool

config SND_SOC_DIGITAL_CDC
	bool

config SND_SOC_DIGITAL_CDC_LEGACY
	bool
```

## techpack/audio/asoc/codecs/tas2557/Kconfig
```kconfig
menuconfig SND_SOC_TAS2557
	tristate "Texas Instruments TAS2557 SmartAmp(R)"
	select SPK_ID

config TAS2557_REGMAP
	depends on SND_SOC_TAS2557
	bool "Use of RegMap API"

config TAS2557_CODEC
	depends on SND_SOC_TAS2557
	bool "Codec Driver support"

config TAS2557_MISC
	depends on SND_SOC_TAS2557
	bool "Misc Driver support"
```

## techpack/audio/asoc/codecs/tas2562/Kconfig
```kconfig
menuconfig SND_SOC_TAS2562
	tristate "Texas Instruments TAS2562 SmartAmp(R)"

config TAS2562_REGMAP
	depends on SND_SOC_TAS2562
	bool "Use of RegMap API"

config TAS2562_CODEC
	depends on SND_SOC_TAS2562
	bool "Codec Driver support"

config TAS2562_MISC
	depends on SND_SOC_TAS2562
	bool "Misc Driver support"
```

## techpack/audio/asoc/codecs/wcd934x/Kconfig
```kconfig
config SND_SOC_WCD934X
	bool

config SND_SOC_WCD934X_MBHC
	bool

config SND_SOC_WCD934X_DSD
	bool
```

## techpack/audio/dsp/Kconfig
```kconfig
config DTS_SRS_TM
	bool

config MSM_CSPL
	bool

config MSM_ADSP_LOADER
	bool

config MSM_QDSP6_NOTIFIER
	bool

config MSM_QDSP6_PDR
	bool

config MSM_QDSP6_SSR
	bool

config MSM_ULTRASOUND
	bool

config SND_SOC_MSM_QDSP6V2_INTF
	bool

source "techpack/audio/dsp/codecs/Kconfig"
```

## techpack/audio/ipc/Kconfig
```kconfig
config MSM_BG_GLINK
	bool

config MSM_QDSP6_APRV2
	bool

config MSM_QDSP6_APRV2_GLINK
	bool

config MSM_QDSP6_APRV3
	bool

config MSM_QDSP6_APRV3_GLINK
	bool

config WCD_DSP_GLINK
	bool
```

## techpack/audio/soc/Kconfig
```kconfig
config PINCTRL_LPI
	bool

config PINCTRL_WCD
	bool

config SOUNDWIRE
	bool

config SOUNDWIRE_WCD_CTRL
	bool
```
